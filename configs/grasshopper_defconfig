## configs/grasshopper_defconfig
```kconfig
# Architecture
BR2_avr32=y

# Kernel Header Options
BR2_KERNEL_HEADERS_3_0=y
BR2_DEFAULT_KERNEL_HEADERS="3.0.8"

# Filesystems
BR2_TARGET_ROOTFS_JFFS2=y
BR2_TARGET_ROOTFS_JFFS2_FLASH_64=y
BR2_TARGET_ROOTFS_JFFS2_PAGESIZE=0x1000
BR2_TARGET_ROOTFS_JFFS2_EBSIZE=0x10000
BR2_TARGET_ROOTFS_JFFS2_NOCLEANMARKER=y
BR2_TARGET_ROOTFS_JFFS2_PAD=y
BR2_TARGET_ROOTFS_JFFS2_PADSIZE=0x7D0000
BR2_TARGET_ROOTFS_JFFS2_BE=y

# Generic
BR2_TARGET_GENERIC_HOSTNAME="grasshopper"
BR2_TARGET_GENERIC_ISSUE="Grasshopper on Buildroot 2011.11-GIT"

# File System structure
BR2_ROOTFS_DEVICE_TABLE="target/device/atmel/grasshopper/device_table.txt"
BR2_ROOTFS_STATIC_DEVICE_TABLE="target/device/atmel/grasshopper/device_table_dev.txt"

# Bootloader
BR2_TARGET_UBOOT=y
BR2_TARGET_UBOOT_BOARDNAME="grasshopper"
BR2_TARGET_UBOOT_2010_09=y
BR2_TARGET_UBOOT_CUSTOM_PATCH_DIR="target/device/atmel/grasshopper/u-boot"

# Kernel
BR2_LINUX_KERNEL=y
BR2_LINUX_KERNEL_CUSTOM_VERSION=y
BR2_LINUX_KERNEL_CUSTOM_VERSION_VALUE="3.0.8"
BR2_LINUX_KERNEL_PATCH="target/device/atmel/grasshopper/kernel-patches"
BR2_LINUX_KERNEL_USE_DEFCONFIG=y
BR2_LINUX_KERNEL_DEFCONFIG="grasshopper"
BR2_LINUX_KERNEL_INSTALL_TARGET=y
```

## package/enlightenment/Config.in
```kconfig
menuconfig BR2_PACKAGE_ENLIGHTENMENT
	bool "Enlightenment"
	help
		Enlightenment is a window manager. Enlightenment is a desktop shell. Enlightenment is the building blocks to create beautiful applications.
		Enlightenment, or simply e, is a group of people trying to make a new generation of software.
	
		http://www.enlightenment.org

if BR2_PACKAGE_ENLIGHTENMENT
	source package/enlightenment/ecore/Config.in
	source package/enlightenment/eina/Config.in
	source package/enlightenment/edje/Config.in
	source package/enlightenment/eet/Config.in
	source package/enlightenment/efreet/Config.in
	source package/enlightenment/elementary/Config.in
	source package/enlightenment/embryo/Config.in
	source package/enlightenment/evas/Config.in
endif
```

## package/enlightenment/ecore/Config.in
```kconfig
config BR2_PACKAGE_ECORE
	bool "Ecore"
	select BR2_PACKAGE_EVAS
	select BR2_PACKAGE_LIBCURL
	depends on BR2_PACKAGE_EINA
	help
		The Enlightenment Core
		
		http://docs.enlightenment.org/auto/ecore
```

## package/enlightenment/edbus/Config.in
```kconfig
config BR2_PACKAGE_EDBUS
	bool "Edbus"
	depends on BR2_PACKAGE_ECORE && BR2_PACKAGE_DBUS
	help
		This is the start of some basic convenience wrappers around dbus to ease integrating dbus with EFL based applications.

		http://docs.enlightenment.org/auto/edbus/
```

## package/enlightenment/edje/Config.in
```kconfig
config BR2_PACKAGE_EDJE
	bool "Edje"
	select BR2_PACKAGE_LUA
	depends on BR2_PACKAGE_EVAS && BR2_PACKAGE_ECORE && BR2_PACKAGE_EET && BR2_PACKAGE_EMBRYO && BR2_PACKAGE_EINA
	help
		Edje is a complex graphical design & layout library.

		http://docs.enlightenment.org/auto/edje/
```

## package/enlightenment/eet/Config.in
```kconfig
config BR2_PACKAGE_EET
	bool "Eet"
	select BR2_PACKAGE_JPEG
	help
		Eet is a tiny library designed to write an arbitrary set of chunks of data to a file and optionally compress each chunk
		(very much like a zip file) and allow fast random-access reading of the file later on. It does not do zip as a zip
		itself has more complexity than is needed, and it was much simpler to implement this once here.

		http://docs.enlightenment.org/auto/eet/
```

## package/enlightenment/efreet/Config.in
```kconfig
config BR2_PACKAGE_EFREET
	bool "Efreet"
	depends on BR2_PACKAGE_EINA && BR2_PACKAGE_ECORE
	help
		Efreet is a library designed to help apps work several of the Freedesktop.org standards regarding Icons, Desktop files and Menus.

		http://docs.enlightenment.org/auto/efreet/
```

## package/enlightenment/elementary/Config.in
```kconfig
config BR2_PACKAGE_ELEMENTARY
	bool "Elementary"
	depends on BR2_PACKAGE_ECORE && BR2_PACKAGE_EVAS && BR2_PACKAGE_EDJE && BR2_PACKAGE_LUA
	help
		This is a VERY SIMPLE toolkit. It is not meant for writing extensive desktop applications (yet). Small simple ones with simple needs.

		http://docs.enlightenment.org/auto/elementary/
```

## package/enlightenment/embryo/Config.in
```kconfig
config BR2_PACKAGE_EMBRYO
	bool "Embryo"
	help
		Embryo is a tiny library designed to interpret limited Small programs compiled by the included compiler, embryo_cc.
		It is mostly a cleaned up and smaller version of the original Small abstract machine. The compiler is mostly untouched.

		http://docs.enlightenment.org/auto/embryo/
```

## package/enlightenment/evas/Config.in
```kconfig
config BR2_PACKAGE_EVAS
	bool "Evas"
	depends on BR2_PACKAGE_EINA && BR2_PACKAGE_FREETYPE
	help
		Evas is a clean and flexible display canvas API. Supports anti-aliased text, smooth super und sub-sampled scaled images, alpha-blend objects and much more.

		http://docs.enlightenment.org/auto/evas/
```

## package/imlib2/Config.in
```kconfig
config BR2_PACKAGE_IMLIB2
	bool "imlib2"
	help
		Imlib 2 is the successor to Imlib. It is NOT a newer version -- it is a completely new library. Imlib 2 can be installed alongside Imlib 1.x without any problems since they are effectively 			different libraries which have very similar functionality. Please see the homepage for the long description of the differences.

		http://www.enlightenment.org
```

## package/multimedia/libplayer/Config.in
```kconfig
config BR2_PACKAGE_LIBPLAYER
	bool "libplayer"
	help
		libplayer provides a generic A/V API that relies on various multimedia player for Linux systems. It currently supports MPlayer, xine VLC and GStreamer only.

		http://libplayer.geexbox.org/

menuconfig BR2_PACKAGE_LIBPLAYER_FEATURES
	bool "libplayer features"
	depends on BR2_PACKAGE_LIBPLAYER
	help
		Selects supported features.

if BR2_PACKAGE_LIBPLAYER_FEATURES

	comment "Wrappers"

	config BR2_PACKAGE_LIBPLAYER_WRAPPER_MPLAYER
	depends on BR2_PACKAGE_MPLAYER
	bool "MPlayer"

	config BR2_PACKAGE_LIBPLAYER_WRAPPER_GSTREAMER
	depends on BR2_PACKAGE_GSTREAMER
	bool "GStreamer"

	config BR2_PACKAGE_LIBPLAYER_WRAPPER_XINE
	depends on BR2_PACKAGE_XINE
	bool "Xine"

	config BR2_PACKAGE_LIBPLAYER_WRAPPER_VLC
	depends on BR2_PACKAGE_VLC
	bool "VLC"

	comment "Advanced"

	config BR2_PACKAGE_LIBPLAYER_X11
	depends on BR2_PACKAGE_XSERVER_XORG_SERVER
	bool "X11 support"

endif
```

## package/multimedia/xine/Config.in
```kconfig
config BR2_PACKAGE_XINE
	bool "xine"
	depends on BR2_PACKAGE_ZLIB
	help
		xine is a free (gpl-licensed) high-performance, portable and reusable multimedia playback engine.
		xine itself is a shared library with an easy to use, yet powerful API which is used by many applications for smooth video playback and video processing purposes.

		http://www.xine-project.org
```

## package/rrdtool/Config.in
```kconfig
config BR2_PACKAGE_RRDTOOL
	bool "rrdtool"
	depends on BR2_USE_WCHAR
	select BR2_PACKAGE_FREETYPE
	select BR2_PACKAGE_LIBART
	select BR2_PACKAGE_LIBPNG
	select BR2_PACKAGE_ZLIB
	help
	  RRDtool is the OpenSource industry standard, high performance
	  data logging and graphing system for time series data.

	  http://oss.oetiker.ch/rrdtool/

comment "rrdtool requires a toolchain with WCHAR support"
	depends on !BR2_USE_WCHAR
	
if BR2_PACKAGE_RRDTOOL

config BR2_PACKAGE_RRDTOOL_NOMMAP
	bool "rrdtool (no mmap)"
	default n
	help
	  This option disables the memory mapped file usage of the RRDTool.
	  This is useful in case the target device uses a flash drive or
	  the used filesystem does not fully support memory mapped IO
	  (such as JFFS2).
endif
```
